## conf/bblayers.conf
```bitbake
# POKY_BBLAYERS_CONF_VERSION is increased each time build/conf/bblayers.conf
# changes incompatibly
POKY_BBLAYERS_CONF_VERSION = "2"

BBPATH = "${TOPDIR}"
BBFILES ?= ""

BBLAYERS ?= " \
  /usr/local/dey-2.6/sources/poky/meta \
  /usr/local/dey-2.6/sources/poky/meta-poky \
  /usr/local/dey-2.6/sources/poky/meta-yocto-bsp \
  /usr/local/dey-2.6/sources/meta-openembedded/meta-oe \
  /usr/local/dey-2.6/sources/meta-openembedded/meta-python \
  /usr/local/dey-2.6/sources/meta-openembedded/meta-networking \
  /usr/local/dey-2.6/sources/meta-openembedded/meta-webserver \
  /usr/local/dey-2.6/sources/meta-qt5 \
  /usr/local/dey-2.6/sources/meta-swupdate \
  /usr/local/dey-2.6/sources/meta-freescale \
  /usr/local/dey-2.6/sources/meta-fsl-demos \
  /usr/local/dey-2.6/sources/meta-digi/meta-digi-arm \
  /usr/local/dey-2.6/sources/meta-digi/meta-digi-dey \
  "
```
